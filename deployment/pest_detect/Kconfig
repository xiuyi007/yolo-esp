## deployment/pest_detect/Kconfig
```kconfig
menu "models: pest_detect"
    config FLASH_PEST_DETECT_YOLO11N_S8_V1
        bool "flash pest_detect_yolo11n_s8_v1"
        depends on !PEST_DETECT_MODEL_IN_SDCARD
        default y
    config FLASH_PEST_DETECT_YOLO11N_S8_V2
        bool "flash pest_detect_yolo11n_s8_v2"
        depends on !PEST_DETECT_MODEL_IN_SDCARD
        default n
    config FLASH_PEST_DETECT_YOLO11S_S8_V1
        bool "flash pest_detect_yolo11s_s8_v1"
        depends on !PEST_DETECT_MODEL_IN_SDCARD
        default y
    config FLASH_PEST_DETECT_YOLO11N_S8_V3
        bool "flash pest_detect_yolo11n_s8_v3"
        depends on !PEST_DETECT_MODEL_IN_SDCARD
        default n
    config FLASH_PEST_DETECT_YOLO11N_320_S8_V3
        bool "flash pest_detect_yolo11n_320_s8_v3"
        depends on !PEST_DETECT_MODEL_IN_SDCARD
        default n
    config FLASH_PEST_DETECT_YOLO11N_S16_V1
        bool "flash pest_detect_yolo11n_s16_v1"
        depends on !PEST_DETECT_MODEL_IN_SDCARD
        default y

    choice
        prompt "default model"
        default PEST_DETECT_YOLO11N_S8_V1
        help
            default pest_detect model
        config PEST_DETECT_YOLO11N_S8_V1
            bool "pest_detect_yolo11n_s8_v1"
            depends on PEST_DETECT_MODEL_IN_SDCARD || FLASH_PEST_DETECT_YOLO11N_S8_V1
        config PEST_DETECT_YOLO11S_S8_V1
            bool "pest_detect_yolo11s_s8_v1"
            depends on PEST_DETECT_MODEL_IN_SDCARD || FLASH_PEST_DETECT_YOLO11S_S8_V1
        config PEST_DETECT_YOLO11N_S8_V2
            bool "pest_detect_yolo11n_s8_v2"
            depends on PEST_DETECT_MODEL_IN_SDCARD || FLASH_PEST_DETECT_YOLO11N_S8_V2
        config PEST_DETECT_YOLO11N_S8_V3
            bool "pest_detect_yolo11n_s8_v3"
            depends on PEST_DETECT_MODEL_IN_SDCARD || FLASH_PEST_DETECT_YOLO11N_S8_V3
        config PEST_DETECT_YOLO11N_320_S8_V3
            bool "pest_detect_yolo11n_320_s8_v3"
            depends on PEST_DETECT_MODEL_IN_SDCARD || FLASH_PEST_DETECT_YOLO11N_320_S8_V3
        config PEST_DETECT_YOLO11N_S16_V1
            bool "pest_detect_yolo11n_s16_v1"
            depends on PEST_DETECT_MODEL_IN_SDCARD || FLASH_PEST_DETECT_YOLO11N_S16_V1
    endchoice

    config DEFAULT_PEST_DETECT_MODEL
        int
        default 0 if PEST_DETECT_YOLO11N_S8_V1
        default 1 if PEST_DETECT_YOLO11N_S8_V2
        default 2 if PEST_DETECT_YOLO11N_S8_V3
        default 3 if PEST_DETECT_YOLO11N_320_S8_V3
        default 4 if PEST_DETECT_YOLO11S_S8_V1
        default 5 if PEST_DETECT_YOLO11N_S16_V1

    choice
        prompt "model location"
        default PEST_DETECT_MODEL_IN_FLASH_RODATA
        help
            PEST_detect model location
        config PEST_DETECT_MODEL_IN_FLASH_RODATA
            bool "flash_rodata"
        config PEST_DETECT_MODEL_IN_FLASH_PARTITION
            bool "flash_partition"
        config PEST_DETECT_MODEL_IN_SDCARD
            bool "sdcard"
    endchoice

    config PEST_DETECT_MODEL_LOCATION
        int
        default 0 if PEST_DETECT_MODEL_IN_FLASH_RODATA
        default 1 if PEST_DETECT_MODEL_IN_FLASH_PARTITION
        default 2 if PEST_DETECT_MODEL_IN_SDCARD

    config PEST_DETECT_MODEL_SDCARD_DIR
        string "pest_detect model sdcard dir"
        default "models/s3" if IDF_TARGET_ESP32S3
        default "models/p4" if IDF_TARGET_ESP32P4
        depends on PEST_DETECT_MODEL_IN_SDCARD
        help
            Directory of models relative to sdcard mount point.
endmenu
```
